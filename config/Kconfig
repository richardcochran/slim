## config/Kconfig
```kconfig
menu "Board Settings"

config karch
	prompt "Linux Kernel Architecture"
	default ""
	string
	help
	 When compiling a Linux kernel, use this value for the ARCH
	 environment variable.

config kvers
	prompt "Linux Kernel Version"
	default "v3.14.33"
	string
	help
	 When compiling a Linux kernel, use this branch, SHA1, or
	 tag. Ideally this should match the version in the board
	 specific Config.linux file.

config kdtb
	prompt "Linux Kernel Device Tree Blob"
	default ""
	string
	help
	 When compiling a Linux kernel, also compile and install this
	 device tree.  Enter the name including the .dtb extension.
	 If your board does not need a device tree, then leave this
	 blank.

config krfs
	prompt "Linux Kernel in the root file system"
	bool
	help
	 When compiling a Linux kernel, install the kernel into the
	 root file system under the /boot directory.

config ipipe_vers
	prompt "I-pipe Linux Kernel Version"
	default "ipipe-3.14"
	string
	help
	 When compiling an I-pipe Linux kernel, use this branch, SHA1,
	 or tag.  Ideally this should match the version in the board
	 specific Config.ipipe file.

config cflags
	prompt "GNU autoconf cflags"
	default "-O2"
	string
	help
	 When compiling a package that uses the GNU autoconf system,
	 use this value for the CFLAGS environment variable.

config ac_target
	prompt "GNU autoconf target"
	default ""
	string
	help
	 When compiling a package that uses the GNU autoconf system,
	 use this value for the --host flag to the configure
	 script. This flag describes the target machine where the
	 programs should run and is sometimes the same as or similar
	 to the name of the cross compiler.

endmenu

config essential
	default y
	bool
	select basefiles
	select manifest
	select startup
```

## vol/Kconfig
```kconfig
comment "Image Options"

config manifest
	prompt "manifest"
	default y
	bool
	help
	 Create a manifest of contents in the image.

config startup
	prompt "startup script"
	default y
	bool
	help
	 Run the startup script when booting the system.

config tftp_dir
	prompt "tftp directory"
	default "/home/tftp"
	string
	help
	 Path to a directory on the development machine into which
	 images are installed. If you are serving images to your
	 embedded devices via TFTP, then set this to the server's root
	 directory. If you do not have a TFTP server, then just ignore
	 this option.

comment "Image Types"

menuconfig initrd
	prompt "initrd"
	default n
	bool
	help
	 Create a initial RAM disk image.

if initrd

config initrd_size
	prompt "initrd size KB"
	default 16384
	int
	help
	 Size of the initial RAM disk in kilobytes.

config uboot_initrd
	prompt "uboot wrapper"
	default y
	bool
	help
	 Say yes here to produce an initial RAM disk wrapped in an
	 image suitable for use with the u-boot boot loader.

endif

menuconfig jffs2
	prompt "jffs2"
	default n
	bool
	help
	 Create a jffs2 flash image.

if jffs2

config jffs2_ebs
	prompt "jffs2 erase block size"
	default 0x20000
	hex
	help
	 Size of the jffs2 erase block size in bytes. However, if you
	 give a value less than 0x1000, the image making tool assumes
	 you mean kilobytes instead.

config jffs2_pad
	prompt "jffs2 total image size"
	default 0xC00000
	hex
	help
	 Size of the jffs2 image bytes.

config jffs2_ext
	prompt "jffs2 extra options"
	default "-b -U"
	string
	help
	 This string will be appended to the image making tool's
	 command line. There are quite a number of options to choose
	 from. See MKFS.JFFS2(1) for more information.

endif

menuconfig romfs
	prompt "romfs"
	default n
	bool
	help
	 Create a ROMfs image.

if romfs

config romfs_label
	prompt "romfs volume label"
	default "ROMdisk"
	string
	help
	 This string will be used as the image's volume label.

endif

config tarball
	prompt "tgz file"
	default n
	bool
	help
	 Create a gzipped tar file containing the image.

menuconfig ubifs
	prompt "ubifs"
	default n
	bool
	help
	 Create a ubifs flash image.

if ubifs

config ubi_ebs
	prompt "UBI erase block size"
	default 129024
	int

config ubi_ext
	prompt "UBI extra options"
	default "-U -m 2048 -c 4074"
	string

config ubinize_opt
	prompt "ubinize options"
	default "-s 512 -O 512 -p 131072 -m 2048"
	string

config ubi_volume_name
	prompt "UBI volume name"
	default "root"
	string

config ubi_volume_size
	prompt "UBI volume size"
	default "250MiB"
	string

endif
```
